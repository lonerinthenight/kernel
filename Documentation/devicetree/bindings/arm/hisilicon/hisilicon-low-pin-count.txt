## Documentation/devicetree/bindings/arm/hisilicon/hisilicon-low-pin-count.txt
```
Hisilicon Hip06 low-pin-count device
  Usually LPC controller is part of PCI host bridge, so the legacy ISA ports
  locate on LPC bus can be accessed direclty. But some SoCs have independent
  LPC controller, and access the legacy ports by triggering LPC I/O cycles.
  Hisilicon Hip06 implements this LPC device.

Required properties:
- compatible: should be "hisilicon,low-pin-count"
- #address-cells: must be 2 which stick to the ISA/EISA binding doc.
- #size-cells: must be 1 which stick to the ISA/EISA binding doc.
- reg: base memory range where the register set for this device is mapped.
- ranges: Optional. Define a 1:1 mapping between the memory space of the child
	  device and the parent. When there is no any memory reg properties in
	  children, this is not needed.

Note:
  The node name before '@' must be "isa" to represent the binding stick to the
  ISA/EISA binding specification.

Example:

isa@a01b0000 {
	compatible = "hisilicom,low-pin-count";
	#address-cells = <2>;
	#size-cells = <1>;
	reg = <0x0 0xa01b0000 0x0 0x1000>;

	ipmi0: bt@e4 {
		compatible = "ipmi-bt";
		device_type = "ipmi";
		reg = <0x01 0xe4 0x04>;
		status = "disabled";
	};
};
```

## Documentation/devicetree/bindings/serial/hisi-lpc-uart.txt
```
* Hisilicon hip06 UART through low-pin-count

Required properties:
- compatible : "hisilicon,lpc-uart", "ns16550a"
- clock-frequency: mandatory. It is 1843200.
- reg : the resource ranges for this device.
		I/O range is mandatory.
		memory range is optional. If flat-tree earlycon is to be used,
		it is mandatory and must populate the first reg property.
- reg-names : optional. name the uart resources.
		"lpc_mem" represents memory resource of the LPC parent. When
		flat-tree earlycon is needed, this memory resource and
		resource name are mandatory. Otherwise they are optional;
		"dev_io" represents I/O resource of this device. It is
		mandatory to access this device;

Clock handling:
  The clock rate of this device is same as the 8250 default clock rate, that
  is 1843200.

Note:
  This device depends on its parent device whose compatible string is
  "hisilicon,low-pin-count".

  The format of "reg" property follows the I/O space definition in ISA/EISA
  binding specification linked to:
  http://www.firmware.org/1275/bindings/isa/isa0_4d.ps

Example:

	uart0: lpc-uart@2f8 {
		compatible = "hisilicon,lpc-uart", "ns16550a";
		clock-frequency = <1843200>;
		reg = <0x00 0xa01b0000 0x1000>,
			<0x01 0x2f8 0x08>;
		status = "disabled";
	};


Example with low-pin-count parent device:

	isa@a01b0000 {
		compatible = "hisilicon,low-pin-count";
		#address-cells = <2>;
		#size-cells = <1>;
		reg = <0x0 0xa01b0000 0x0 0x1000>;
		ranges = <0x00 0xa01b0000 0x00 0xa01b0000 0x1000>;

		ipmi0: bt@e4 {
			compatible = "ipmi-bt";
			device_type = "ipmi";
			reg = <0x01 0xe4 0x04>;
			reg-names = "dev_io";
			status = "disabled";
		};

		uart0: lpc-uart@2f8 {
			compatible = "hisilicon,lpc-uart", "ns16550a";
			clock-frequency = <1843200>;
			reg =  <0x00 0xa01b0000 0x1000>,
				<0x01 0x2f8 0x08>;
			ret-names = "lpc_mem", "dev_io";
			status = "disabled";
		};
	};
```
